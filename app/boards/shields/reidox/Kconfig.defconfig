## app/boards/shields/reidox/Kconfig.defconfig
```kconfig
# Copyright (c) 2021 The ZMK Contributors
# SPDX-License-Identifier: MIT
if SHIELD_REIDOX_RIGHT

config ZMK_KEYBOARD_NAME
	default "Reidox"

config ZMK_SPLIT_ROLE_CENTRAL
	default y

endif

if SHIELD_REIDOX_LEFT

config ZMK_SPLIT_ROLE_CENTRAL
	default n

endif

if SHIELD_REIDOX_LEFT || SHIELD_REIDOX_RIGHT

config ZMK_SPLIT
	default y

endif
```

## app/boards/shields/reidox/Kconfig.shield
```kconfig
# Copyright (c) 2021 The ZMK Contributors
# SPDX-License-Identifier: MIT
config SHIELD_REIDOX_LEFT
	def_bool $(shields_list_contains,reidox_left)

config SHIELD_REIDOX_RIGHT
	def_bool $(shields_list_contains,reidox_right)
```
